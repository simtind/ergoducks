## boards/arm/ergoducks_graviton/Kconfig.board
```kconfig
# Ergoducks board configuration

# Copyright (c) 2025 Simen August Tinderholt
# SPDX-License-Identifier: MIT

config BOARD_ERGODUCKS_GRAVITON
    bool "ergoducks graviton controller"
    depends on SOC_NRF52840_QIAA
```

## boards/arm/ergoducks_grvton/Kconfig.defconfig
```kconfig
# Copyright (c) 2021 The ZMK Contributors
# SPDX-License-Identifier: MIT

if BOARD_ERGODUCKS_GRAVITON

config BOARD
    default "ergoducks_grvton"

if USB || USB_DEVICE_STACK

config USB_NRFX
    default y

endif # USB

config BT_CTLR
    default BT

endif # BOARD_ERGODUCKS_GRAVITON
```

## boards/arm/ergoducks_grvton/Kconfig.ergoducks_grvton
```kconfig
# Ergoducks board configuration

# Copyright (c) 2025 Simen August Tinderholt
# SPDX-License-Identifier: MIT

config BOARD_ERGODUCKS_GRAVITON
    bool "ergoducks graviton controller"
    depends on SOC_NRF52840_QIAA
    imply RETAINED_MEM
    imply RETENTION
    imply RETENTION_BOOT_MODE
```

## boards/arm/ergoducks_grvton/board.yml
```yaml
board:
  name: ergoducks_grvton
  vendor: ergoducks
  socs:
    - name: nrf52840
  revision:
    format: major.minor.patch
    default: 1.0.0
    revisions:
      - name: 1.0.0
```

## boards/ergoducks/graviton/board.yml
```yaml
board:
  name: graviton
  vendor: ergoducks
  socs:
    - name: nrf52840
  revision:
    format: major.minor.patch
    default: 1.0.0
    revisions:
      - name: 1.0.0
```

## boards/shields/ergoducks/Kconfig.defconfig
```kconfig
if SHIELD_ERGODUCKS_LEFT

config ZMK_KEYBOARD_NAME
    default "ergoducks"

config ZMK_SPLIT_ROLE_CENTRAL
    default y

endif # SHIELD_ERGODUCKS_LEFT

if SHIELD_ERGODUCKS_LEFT || SHIELD_ERGODUCKS_RIGHT

config ZMK_SPLIT
    default y

if ZMK_RGB_UNDERGLOW

    config WS2812_STRIP_I2S
        default y

endif

if EC11

    config EC11_TRIGGER_GLOBAL_THREAD
        default y

endif

if ZMK_DISPLAY

    config I2C
        default y

    config SSD1306
        default y

endif # ZMK_DISPLAY

if LVGL

config LV_Z_VDB_SIZE
    default 64

config LV_DPI_DEF
    default 148

config LV_Z_BITS_PER_PIXEL
    default 1

choice LV_COLOR_DEPTH
    default LV_COLOR_DEPTH_1
endchoice

endif # LVGL

endif # SHIELD_ERGODUCKS_LEFT || SHIELD_ERGODUCKS_RIGHT
```

## boards/shields/ergoducks/Kconfig.shield
```kconfig
config SHIELD_ERGODUCKS_LEFT
    def_bool $(shields_list_contains,ergoducks_left)

config SHIELD_ERGODUCKS_RIGHT
    def_bool $(shields_list_contains,ergoducks_right)
```

## firmware/boards/shields/ergoducks/Kconfig.shield
```kconfig
# Copyright (c) 2020 The ZMK Contributors
# SPDX-License-Identifier: MIT

config SHIELD_ERGODUCKS_LEFT
    def_bool $(shields_list_contains,ergoducks_left)

config SHIELD_ERGODUCKS_RIGHT
    def_bool $(shields_list_contains,ergoducks_right)
```
